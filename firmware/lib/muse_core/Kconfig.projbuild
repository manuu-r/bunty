## firmware/lib/muse_core/Kconfig.projbuild
```kconfig
config BUNTY_MUSE
    bool "Use Muse for Bunty's assistant connection"
    default y
config MUSE_ENABLED
    bool
    default n
config MUSE_HATCH
    bool
    default n
rsource "../../.deps/muse/esp32/main/Kconfig.projbuild"
```

## firmware/sdkconfig.defaults
```kconfig
CONFIG_IDF_TARGET="esp32s3"
CONFIG_ESPTOOLPY_FLASHSIZE_8MB=y
CONFIG_ESPTOOLPY_FLASHMODE_QIO=y
CONFIG_PARTITION_TABLE_CUSTOM=y
CONFIG_PARTITION_TABLE_CUSTOM_FILENAME="partitions.csv"
CONFIG_SPIRAM=y
CONFIG_SPIRAM_MODE_OCT=y
CONFIG_SPIRAM_SPEED_80M=y
CONFIG_SPIRAM_USE_MALLOC=y
CONFIG_SPIRAM_MALLOC_ALWAYSINTERNAL=16384
CONFIG_SPIRAM_MALLOC_RESERVE_INTERNAL=65536
CONFIG_SPIRAM_MEMTEST=y
CONFIG_ESP_CONSOLE_USB_SERIAL_JTAG=y
CONFIG_FREERTOS_HZ=1000
CONFIG_FREERTOS_SUPPORT_STATIC_ALLOCATION=y
CONFIG_ESP_MAIN_TASK_STACK_SIZE=8192
CONFIG_BT_ENABLED=y
CONFIG_BT_BLUEDROID_ENABLED=n
CONFIG_BT_NIMBLE_ENABLED=y
CONFIG_BT_BLE_ENABLED=y
CONFIG_BT_GATTS_ENABLE=y
CONFIG_BT_BLE_SMP_ENABLE=y
CONFIG_BT_BLE_42_FEATURES_SUPPORTED=y
CONFIG_MBEDTLS_DYNAMIC_BUFFER=y
CONFIG_MBEDTLS_CERTIFICATE_BUNDLE=y
CONFIG_COMPILER_CXX_EXCEPTIONS=n
CONFIG_PM_ENABLE=y

CONFIG_BUNTY_MUSE=y
CONFIG_HOMEHUB_LED_BACKEND_NONE=y
CONFIG_HOMEHUB_VOICE=y
CONFIG_HOMEHUB_TUNNEL=n
CONFIG_HOMEHUB_NVS_ENCRYPTION=n
CONFIG_HOMEHUB_PAIRING_EFUSE_AUTH=n
CONFIG_HOMEHUB_OTA_ENABLED=n
CONFIG_HOMEHUB_BLE_NAME_PREFIX="MuseGadget-Bunty-"
CONFIG_GADGET_PRODUCT_NAME="Bunty"
CONFIG_MBEDTLS_EXTERNAL_MEM_ALLOC=y
CONFIG_MBEDTLS_INTERNAL_MEM_ALLOC=n
CONFIG_LWIP_IP_FORWARD=y
CONFIG_LWIP_IPV4_NAPT=y
CONFIG_FREERTOS_TASK_CREATE_ALLOW_EXT_MEM=y
CONFIG_CJSON_NESTING_LIMIT=16
CONFIG_ESP32S3_DEFAULT_CPU_FREQ_240=y
CONFIG_ESP32S3_DEFAULT_CPU_FREQ_MHZ=240
CONFIG_ESP_TLS_CLIENT_SESSION_TICKETS=y
CONFIG_MBEDTLS_COMPILER_OPTIMIZATION_PERF=y
CONFIG_ESP_HTTP_CLIENT_SAVE_RESPONSE_HEADERS=y

# On-device "Hey Buddy" wake word: Espressif's wn10_en_heybuddy, read from the model partition.
CONFIG_SR_WN_WN10_EN_HEYBUDDY=y
```
